#include "../common/sdhc.dtsi"
#include "../common/pinctrl.dtsi"
#include "android.dtsi"
#include "display.dtsi"
#include "touchscreen.dtsi"
#include "camera.dtsi"
#include "audio.dtsi"
#include "misc.dtsi"
#include "pinctrl.dtsi"
#include "fingerprint.dtsi"
#include "pmic.dtsi"
#include "battery.dtsi"

&msm_gpu {
	qcom,enable-midframe-timer;
	qcom,ca-busy-penalty = <8000>;
};